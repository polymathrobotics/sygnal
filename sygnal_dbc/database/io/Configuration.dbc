VERSION ""

NS_ :

BS_:

BU_: UserApplication MCM
VAL_TABLE_ Config_ParameterID_IOGlobal 1 "Seed Rate" ;
VAL_TABLE_ Config_SectionID 31 "SygnalStatic" 8 "Signal" 7 "Heartbeat" 6 "Control" 3 "Error" 2 "Fault" 1 "IOGlobal" 0 "SygnalGlobal" ;
VAL_TABLE_ Config_Value_Signal_Type 255 "None" 4 "Open Drain" 3 "Push Pull Vin" 2 "Push Pull 5V" 1 "Analog Out" 0 "Analog In" ;
VAL_TABLE_ Config_GetSet 1 "Set" 0 "Get" ;
VAL_TABLE_ Config_ParameterID_SygnalStatic 9 "Manufacturing Second" 8 "Manufacturing Minute" 7 "Manufacturing Hour" 6 "Manufacturing Day" 5 "Manufacturing Month" 4 "Manufacturing Year" 3 "Serial" 2 "Revision" 1 "Part ID" 0 "Product ID" ;

BO_ 3221225472 VECTOR__INDEPENDENT_SIG_MSG: 0 Vector__XXX
 SG_ Config_Value_IOGlobal_UINT1 : 0|1@1+ (1,0) [0|0] "" Vector__XXX
 SG_ Config_Value_IOGlobal_UINT1 : 0|1@1+ (1,0) [0|0] "" Vector__XXX

BO_ 1025 ConfigGetSetResponse: 8 MCM
 SG_ Config_Value_IOGlobal_UINT32 m0 : 24|32@1+ (1,0) [0|0] "" Vector__XXX
 SG_ Config_Value_Signal_Type m0 : 24|8@1+ (1,0) [0|0] "" Vector__XXX
 SG_ Config_Value_Signal_FLOAT32 m2 : 24|32@1- (1,0) [0|0] "" Vector__XXX
 SG_ Config_Value_IOGlobal_FLOAT32 m2 : 24|32@1- (1,0) [0|0] "" Vector__XXX
 SG_ Config_Value_IOGlobal_UINT16 m1 : 24|16@1+ (1,0) [0|0] "" Vector__XXX
 SG_ Config_Value_SygnalStatic_UINT32 m1 : 24|32@1+ (1,0) [0|0] "" Vector__XXX
 SG_ Config_Value_SygnalStatic_UINT24 m0 : 24|24@1+ (1,0) [0|0] "" Vector__XXX
 SG_ Config_Value_SygnalStatic_UINT16 m2 : 24|16@1+ (1,0) [0|0] "" Vector__XXX
 SG_ Config_ParameterID_SygnalStatic m31M : 16|7@1+ (1,0) [0|0] "" Vector__XXX
 SG_ Config_Value_Heartbeat_UINT16 m1 : 24|16@1+ (1,0) [0|0] "" Vector__XXX
 SG_ Config_Value_Heartbeat_UINT1 m2 : 24|1@1+ (1,0) [0|0] "" Vector__XXX
 SG_ Config_Value_SygnalGlobal_UINT7 m0 : 24|7@1+ (1,0) [0|0] "" Vector__XXX
 SG_ Config_ParameterID_Report m16M : 16|7@1+ (1,0) [0|0] "" Vector__XXX
 SG_ Config_ParameterID_Signal m8M : 16|7@1+ (1,0) [0|0] "" Vector__XXX
 SG_ Config_ParameterID_Heartbeat m7M : 16|7@1+ (1,0) [0|0] "" Vector__XXX
 SG_ Config_ParameterID_IOGlobal m1M : 16|7@1+ (1,0) [0|0] "" Vector__XXX
 SG_ Config_ParameterID_SygnalGlobal m0M : 16|7@1+ (1,0) [0|0] "" Vector__XXX
 SG_ CRC : 56|8@1+ (1,0) [0|0] "" Vector__XXX
 SG_ Config_GetSet : 23|1@1+ (1,0) [0|0] "" Vector__XXX
 SG_ Config_InterfaceID : 13|3@1+ (1,0) [0|0] "" Vector__XXX
 SG_ Config_SectionID M : 8|5@1+ (1,0) [0|0] "" Vector__XXX
 SG_ SubsystemID : 7|1@1+ (1,0) [0|0] "" Vector__XXX
 SG_ BusAddress : 0|7@1+ (1,0) [0|0] "" Vector__XXX

BO_ 1024 ConfigGetSetCommand: 8 UserApplication
 SG_ Config_Value_IOGlobal_UINT32 m0 : 24|32@1+ (1,0) [0|0] "" Vector__XXX
 SG_ Config_Value_IOGlobal_FLOAT32 m2 : 24|32@1- (1,0) [0|0] "" Vector__XXX
 SG_ Config_Value_Signal_Type m0 : 24|8@1+ (1,0) [0|0] "" Vector__XXX
 SG_ Config_Value_IOGlobal_UINT16 m1 : 24|16@1+ (1,0) [0|0] "" Vector__XXX
 SG_ Config_Value_SygnalStatic_UINT32 m1 : 24|32@1+ (1,0) [0|0] "" Vector__XXX
 SG_ Config_Value_SygnalStatic_UINT24 m0 : 24|24@1+ (1,0) [0|0] "" Vector__XXX
 SG_ Config_Value_SygnalStatic_UINT16 m2 : 24|16@1+ (1,0) [0|0] "" Vector__XXX
 SG_ Config_ParameterID_SygnalStatic m31M : 16|7@1+ (1,0) [0|0] "" Vector__XXX
 SG_ Config_Value_Heartbeat_UINT16 m1 : 24|16@1+ (1,0) [0|0] "" Vector__XXX
 SG_ Config_Value_Heartbeat_UINT1 m2 : 24|1@1+ (1,0) [0|0] "" Vector__XXX
 SG_ Config_Value_Signal_FLOAT32 m2 : 24|32@1- (1,0) [0|0] "" Vector__XXX
 SG_ Config_Value_SygnalGlobal_UINT7 m0 : 24|7@1+ (1,0) [0|0] "" Vector__XXX
 SG_ Config_ParameterID_Report m16M : 16|7@1+ (1,0) [0|0] "" Vector__XXX
 SG_ Config_ParameterID_Signal m8M : 16|7@1+ (1,0) [0|0] "" Vector__XXX
 SG_ Config_ParameterID_Heartbeat m7M : 16|7@1+ (1,0) [0|0] "" Vector__XXX
 SG_ Config_ParameterID_IOGlobal m1M : 16|7@1+ (1,0) [0|0] "" Vector__XXX
 SG_ Config_ParameterID_SygnalGlobal m0M : 16|7@1+ (1,0) [0|0] "" Vector__XXX
 SG_ CRC : 56|8@1+ (1,0) [0|0] "" Vector__XXX
 SG_ Config_GetSet : 23|1@1+ (1,0) [0|0] "" Vector__XXX
 SG_ Config_InterfaceID : 13|3@1+ (1,0) [0|0] "" Vector__XXX
 SG_ Config_SectionID M : 8|5@1+ (1,0) [0|0] "" Vector__XXX
 SG_ SubsystemID : 7|1@1+ (1,0) [0|0] "" Vector__XXX
 SG_ BusAddress : 0|7@1+ (1,0) [0|0] "" Vector__XXX

CM_ BO_ 3221225472 "This is a message for not used signals, created by Vector CANdb++ DBC OLE DB Provider.";
BA_DEF_ SG_  "SigType" ENUM  "Default","Range","RangeSigned","ASCII","Discrete","Control","ReferencePGN","DTC","StringDelimiter","StringLength","StringLengthControl","MessageCounter","MessageChecksum";
BA_DEF_ SG_  "GenSigEVName" STRING ;
BA_DEF_ SG_  "GenSigILSupport" ENUM  "No","Yes";
BA_DEF_ SG_  "GenSigSendType" ENUM  "Cyclic","OnWrite","OnWriteWithRepetition","OnChange","OnChangeWithRepetition","IfActive","IfActiveWithRepetition","NoSigSendType";
BA_DEF_ BO_  "GenMsgILSupport" ENUM  "No","Yes";
BA_DEF_ BU_  "NmStationAddress" INT 0 255;
BA_DEF_ BO_  "GenMsgSendType" ENUM  "cyclic","NotUsed","IfActive","NotUsed","NotUsed","NotUsed","NotUsed","NotUsed","noMsgSendType";
BA_DEF_ BO_  "GenMsgRequestable" INT 0 1;
BA_DEF_  "DBName" STRING ;
BA_DEF_  "BusType" STRING ;
BA_DEF_  "ProtocolType" STRING ;
BA_DEF_ BO_  "VFrameFormat" ENUM  "StandardCAN","ExtendedCAN","reserved","J1939PG";
BA_DEF_DEF_  "SigType" "Default";
BA_DEF_DEF_  "GenSigEVName" "Env@Nodename_@Signame";
BA_DEF_DEF_  "GenSigILSupport" "Yes";
BA_DEF_DEF_  "GenSigSendType" "NoSigSendType";
BA_DEF_DEF_  "GenMsgILSupport" "Yes";
BA_DEF_DEF_  "NmStationAddress" 254;
BA_DEF_DEF_  "GenMsgSendType" "noMsgSendType";
BA_DEF_DEF_  "GenMsgRequestable" 1;
BA_DEF_DEF_  "DBName" "";
BA_DEF_DEF_  "BusType" "CAN";
BA_DEF_DEF_  "ProtocolType" "J1939";
BA_DEF_DEF_  "VFrameFormat" "J1939PG";
BA_ "DBName" "Configuration";
BA_ "NmStationAddress" BU_ UserApplication 241;
BA_ "NmStationAddress" BU_ MCM 0;
BA_ "VFrameFormat" BO_ 1025 0;
BA_ "VFrameFormat" BO_ 1024 0;
VAL_ 1025 Config_Value_Signal_Type 255 "None" 4 "Open Drain" 3 "Push Pull Vin" 2 "Push Pull 5V" 1 "Analog Out" 0 "Analog In" ;
VAL_ 1025 Config_ParameterID_SygnalStatic 71 "Lock" 9 "Manufacturing Second" 8 "Manufacturing Minute" 7 "Manufacturing Hour" 6 "Manufacturing Day" 5 "Manufacturing Month" 4 "Manufacturing Year" 3 "Serial" 2 "Revision" 1 "Part ID" 0 "Product ID" ;
VAL_ 1025 Config_ParameterID_Signal 2 "Signal Scale Negative" 4 "Signal Offset" 3 "Signal Scale Positive" 0 "Signal Type" ;
VAL_ 1025 Config_ParameterID_Heartbeat 6 "Host Heartbeat Startup Delay" 5 "Host Heartbeat Count Enable" 4 "Host Heartbeat Timeout" 3 "Host Heartbeat CAN ID" 2 "Host Heartbeat Enable" 1 "MCM Heartbeat Rate" ;
VAL_ 1025 Config_ParameterID_IOGlobal 1 "Seed Rate" ;
VAL_ 1025 Config_ParameterID_SygnalGlobal 0 "Bus Address" ;
VAL_ 1025 Config_GetSet 1 "Set" 0 "Get" ;
VAL_ 1025 Config_SectionID 31 "SygnalStatic" 8 "Signal" 7 "Heartbeat" 6 "Control" 3 "Error" 2 "Fault" 1 "IOGlobal" 0 "SygnalGlobal" ;
VAL_ 1024 Config_Value_Signal_Type 255 "None" 4 "Open Drain" 3 "Push Pull Vin" 2 "Push Pull 5V" 1 "Analog Out" 0 "Analog In" ;
VAL_ 1024 Config_ParameterID_SygnalStatic 71 "Lock" 9 "Manufacturing Second" 8 "Manufacturing Minute" 7 "Manufacturing Hour" 6 "Manufacturing Day" 5 "Manufacturing Month" 4 "Manufacturing Year" 3 "Serial" 2 "Revision" 1 "Part ID" 0 "Product ID" ;
VAL_ 1024 Config_ParameterID_Signal 2 "Signal Scale Negative" 4 "Signal Offset" 3 "Signal Scale Positive" 0 "Signal Type" ;
VAL_ 1024 Config_ParameterID_Heartbeat 6 "Host Heartbeat Startup Delay" 5 "Host Heartbeat Count Enable" 4 "Host Heartbeat Timeout" 3 "Host Heartbeat CAN ID" 2 "Host Heartbeat Enable" 1 "MCM Heartbeat Rate" ;
VAL_ 1024 Config_ParameterID_IOGlobal 1 "Seed Rate" ;
VAL_ 1024 Config_ParameterID_SygnalGlobal 0 "Bus Address" ;
VAL_ 1024 Config_GetSet 1 "Set" 0 "Get" ;
VAL_ 1024 Config_SectionID 31 "SygnalStatic" 8 "Signal" 7 "Heartbeat" 6 "Control" 3 "Error" 2 "Fault" 1 "IOGlobal" 0 "SygnalGlobal" ;
SIG_VALTYPE_ 1025 Config_Value_Signal_FLOAT32 : 1;
SIG_VALTYPE_ 1025 Config_Value_IOGlobal_FLOAT32 : 1;
SIG_VALTYPE_ 1024 Config_Value_IOGlobal_FLOAT32 : 1;
SIG_VALTYPE_ 1024 Config_Value_Signal_FLOAT32 : 1;

SG_MUL_VAL_ 1025 Config_Value_IOGlobal_UINT32 Config_ParameterID_IOGlobal 0-0;
SG_MUL_VAL_ 1025 Config_Value_Signal_Type Config_ParameterID_Signal 0-0;
SG_MUL_VAL_ 1025 Config_Value_Signal_FLOAT32 Config_ParameterID_Signal 2-4;
SG_MUL_VAL_ 1025 Config_Value_IOGlobal_FLOAT32 Config_ParameterID_IOGlobal 2-4;
SG_MUL_VAL_ 1025 Config_Value_IOGlobal_UINT16 Config_ParameterID_IOGlobal 1-1;
SG_MUL_VAL_ 1025 Config_Value_SygnalStatic_UINT32 Config_ParameterID_SygnalStatic 1-1, 3-4;
SG_MUL_VAL_ 1025 Config_Value_SygnalStatic_UINT24 Config_ParameterID_SygnalStatic 0-0;
SG_MUL_VAL_ 1025 Config_Value_SygnalStatic_UINT16 Config_ParameterID_SygnalStatic 2-2, 5-9, 71-71;
SG_MUL_VAL_ 1025 Config_ParameterID_SygnalStatic Config_SectionID 31-31;
SG_MUL_VAL_ 1025 Config_Value_Heartbeat_UINT16 Config_ParameterID_Heartbeat 1-1, 3-4, 6-6;
SG_MUL_VAL_ 1025 Config_Value_Heartbeat_UINT1 Config_ParameterID_Heartbeat 2-2, 5-5;
SG_MUL_VAL_ 1025 Config_Value_SygnalGlobal_UINT7 Config_ParameterID_SygnalGlobal 0-0;
SG_MUL_VAL_ 1025 Config_ParameterID_Report Config_SectionID 16-16;
SG_MUL_VAL_ 1025 Config_ParameterID_Signal Config_SectionID 8-8;
SG_MUL_VAL_ 1025 Config_ParameterID_Heartbeat Config_SectionID 7-7;
SG_MUL_VAL_ 1025 Config_ParameterID_IOGlobal Config_SectionID 1-1;
SG_MUL_VAL_ 1025 Config_ParameterID_SygnalGlobal Config_SectionID 0-0;
SG_MUL_VAL_ 1024 Config_Value_IOGlobal_UINT32 Config_ParameterID_IOGlobal 0-0;
SG_MUL_VAL_ 1024 Config_Value_IOGlobal_FLOAT32 Config_ParameterID_IOGlobal 2-4;
SG_MUL_VAL_ 1024 Config_Value_Signal_Type Config_ParameterID_Signal 0-0;
SG_MUL_VAL_ 1024 Config_Value_IOGlobal_UINT16 Config_ParameterID_IOGlobal 1-1;
SG_MUL_VAL_ 1024 Config_Value_SygnalStatic_UINT32 Config_ParameterID_SygnalStatic 1-1, 3-4;
SG_MUL_VAL_ 1024 Config_Value_SygnalStatic_UINT24 Config_ParameterID_SygnalStatic 0-0;
SG_MUL_VAL_ 1024 Config_Value_SygnalStatic_UINT16 Config_ParameterID_SygnalStatic 2-2, 5-9, 71-71;
SG_MUL_VAL_ 1024 Config_ParameterID_SygnalStatic Config_SectionID 31-31;
SG_MUL_VAL_ 1024 Config_Value_Heartbeat_UINT16 Config_ParameterID_Heartbeat 1-1, 3-4, 6-6;
SG_MUL_VAL_ 1024 Config_Value_Heartbeat_UINT1 Config_ParameterID_Heartbeat 2-2, 5-5;
SG_MUL_VAL_ 1024 Config_Value_Signal_FLOAT32 Config_ParameterID_Signal 2-4;
SG_MUL_VAL_ 1024 Config_Value_SygnalGlobal_UINT7 Config_ParameterID_SygnalGlobal 0-0;
SG_MUL_VAL_ 1024 Config_ParameterID_Report Config_SectionID 16-16;
SG_MUL_VAL_ 1024 Config_ParameterID_Signal Config_SectionID 8-8;
SG_MUL_VAL_ 1024 Config_ParameterID_Heartbeat Config_SectionID 7-7;
SG_MUL_VAL_ 1024 Config_ParameterID_IOGlobal Config_SectionID 1-1;
SG_MUL_VAL_ 1024 Config_ParameterID_SygnalGlobal Config_SectionID 0-0;
